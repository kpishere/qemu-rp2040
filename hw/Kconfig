## hw/Kconfig
```kconfig
# RP2040 peripheral configuration

config RP2040_UART
    bool

config RP2040_GPIO
    bool

config RP2040_TIMER
    bool

config RP2040_SPI
    bool

config RP2040_I2C
    bool
```
